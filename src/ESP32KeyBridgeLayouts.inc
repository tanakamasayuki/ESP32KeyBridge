// AUTO-GENERATED by tools/gen_keymaps.py -- do not edit by hand.
// Source: EspUsbHost/src/keymap/keymap_*.h (shared 4-plane tables).
// Regenerate with: python3 tools/gen_keymaps.py
// clang-format off

const KeyboardLayoutEntry kDeDeEntries[] = {
    {U(KeyboardUsage::A), 'a', 'A', true},
    {U(KeyboardUsage::B), 'b', 'B', true},
    {U(KeyboardUsage::C), 'c', 'C', true},
    {U(KeyboardUsage::D), 'd', 'D', true},
    {U(KeyboardUsage::E), 'e', 'E', true, 0x20ac},
    {U(KeyboardUsage::F), 'f', 'F', true},
    {U(KeyboardUsage::G), 'g', 'G', true},
    {U(KeyboardUsage::H), 'h', 'H', true},
    {U(KeyboardUsage::I), 'i', 'I', true},
    {U(KeyboardUsage::J), 'j', 'J', true},
    {U(KeyboardUsage::K), 'k', 'K', true},
    {U(KeyboardUsage::L), 'l', 'L', true},
    {U(KeyboardUsage::M), 'm', 'M', true, 0x00b5},
    {U(KeyboardUsage::N), 'n', 'N', true},
    {U(KeyboardUsage::O), 'o', 'O', true},
    {U(KeyboardUsage::P), 'p', 'P', true},
    {U(KeyboardUsage::Q), 'q', 'Q', true, '@'},
    {U(KeyboardUsage::R), 'r', 'R', true},
    {U(KeyboardUsage::S), 's', 'S', true},
    {U(KeyboardUsage::T), 't', 'T', true},
    {U(KeyboardUsage::U), 'u', 'U', true},
    {U(KeyboardUsage::V), 'v', 'V', true},
    {U(KeyboardUsage::W), 'w', 'W', true},
    {U(KeyboardUsage::X), 'x', 'X', true},
    {U(KeyboardUsage::Y), 'z', 'Z', true},
    {U(KeyboardUsage::Z), 'y', 'Y', true},
    {U(KeyboardUsage::Digit1), '1', '!', false},
    {U(KeyboardUsage::Digit2), '2', '"', false, 0x00b2},
    {U(KeyboardUsage::Digit3), '3', 0x00a7, false, 0x00b3},
    {U(KeyboardUsage::Digit4), '4', '$', false},
    {U(KeyboardUsage::Digit5), '5', '%', false},
    {U(KeyboardUsage::Digit6), '6', '&', false},
    {U(KeyboardUsage::Digit7), '7', '/', false, '{'},
    {U(KeyboardUsage::Digit8), '8', '(', false, '['},
    {U(KeyboardUsage::Digit9), '9', ')', false, ']'},
    {U(KeyboardUsage::Digit0), '0', '=', false, '}'},
    {U(KeyboardUsage::Space), ' ', ' ', false},
    {U(KeyboardUsage::Minus), 0x00df, '?', false, '\\'},
    {U(KeyboardUsage::LeftBracket), 0x00fc, 0x00dc, true},
    {U(KeyboardUsage::RightBracket), '+', '*', false, '~'},
    {U(KeyboardUsage::NonUsHash), '#', '\'', false},
    {U(KeyboardUsage::Semicolon), 0x00f6, 0x00d6, true},
    {U(KeyboardUsage::Quote), 0x00e4, 0x00c4, true},
    {U(KeyboardUsage::Grave), 0, 0x00b0, false},
    {U(KeyboardUsage::Comma), ',', ';', false},
    {U(KeyboardUsage::Period), '.', ':', false},
    {U(KeyboardUsage::Slash), '-', '_', false},
    {U(KeyboardUsage::NonUsBackslash), '<', '>', false, '|'},
};

const KeyboardLayoutEntry kFrFrEntries[] = {
    {U(KeyboardUsage::A), 'q', 'Q', true},
    {U(KeyboardUsage::B), 'b', 'B', true},
    {U(KeyboardUsage::C), 'c', 'C', true},
    {U(KeyboardUsage::D), 'd', 'D', true},
    {U(KeyboardUsage::E), 'e', 'E', true, 0x20ac},
    {U(KeyboardUsage::F), 'f', 'F', true},
    {U(KeyboardUsage::G), 'g', 'G', true},
    {U(KeyboardUsage::H), 'h', 'H', true},
    {U(KeyboardUsage::I), 'i', 'I', true},
    {U(KeyboardUsage::J), 'j', 'J', true},
    {U(KeyboardUsage::K), 'k', 'K', true},
    {U(KeyboardUsage::L), 'l', 'L', true},
    {U(KeyboardUsage::M), ',', '?', false},
    {U(KeyboardUsage::N), 'n', 'N', true},
    {U(KeyboardUsage::O), 'o', 'O', true},
    {U(KeyboardUsage::P), 'p', 'P', true},
    {U(KeyboardUsage::Q), 'a', 'A', true},
    {U(KeyboardUsage::R), 'r', 'R', true},
    {U(KeyboardUsage::S), 's', 'S', true},
    {U(KeyboardUsage::T), 't', 'T', true},
    {U(KeyboardUsage::U), 'u', 'U', true},
    {U(KeyboardUsage::V), 'v', 'V', true},
    {U(KeyboardUsage::W), 'z', 'Z', true},
    {U(KeyboardUsage::X), 'x', 'X', true},
    {U(KeyboardUsage::Y), 'y', 'Y', true},
    {U(KeyboardUsage::Z), 'w', 'W', true},
    {U(KeyboardUsage::Digit1), '&', '1', false},
    {U(KeyboardUsage::Digit2), 0x00e9, '2', false, '~'},
    {U(KeyboardUsage::Digit3), '"', '3', false, '#'},
    {U(KeyboardUsage::Digit4), '\'', '4', false, '{'},
    {U(KeyboardUsage::Digit5), '(', '5', false, '['},
    {U(KeyboardUsage::Digit6), '-', '6', false, '|'},
    {U(KeyboardUsage::Digit7), 0x00e8, '7', false, '`'},
    {U(KeyboardUsage::Digit8), '_', '8', false, '\\'},
    {U(KeyboardUsage::Digit9), 0x00e7, '9', false, '^'},
    {U(KeyboardUsage::Digit0), 0x00e0, '0', false, '@'},
    {U(KeyboardUsage::Space), ' ', ' ', false},
    {U(KeyboardUsage::Minus), ')', 0x00b0, false, ']'},
    {U(KeyboardUsage::Equal), '=', '+', false, '}'},
    {U(KeyboardUsage::RightBracket), '$', 0x00a3, false},
    {U(KeyboardUsage::NonUsHash), '*', 0x00b5, false},
    {U(KeyboardUsage::Semicolon), 'm', 'M', true},
    {U(KeyboardUsage::Quote), 0x00f9, '%', false},
    {U(KeyboardUsage::Grave), 0x00b2, 0, false},
    {U(KeyboardUsage::Comma), ';', '.', false},
    {U(KeyboardUsage::Period), ':', '/', false},
    {U(KeyboardUsage::Slash), '!', 0x00a7, false},
    {U(KeyboardUsage::NonUsBackslash), '<', '>', false},
};

const KeyboardLayoutEntry kEsEsEntries[] = {
    {U(KeyboardUsage::A), 'a', 'A', true},
    {U(KeyboardUsage::B), 'b', 'B', true},
    {U(KeyboardUsage::C), 'c', 'C', true},
    {U(KeyboardUsage::D), 'd', 'D', true},
    {U(KeyboardUsage::E), 'e', 'E', true, 0x20ac},
    {U(KeyboardUsage::F), 'f', 'F', true},
    {U(KeyboardUsage::G), 'g', 'G', true},
    {U(KeyboardUsage::H), 'h', 'H', true},
    {U(KeyboardUsage::I), 'i', 'I', true},
    {U(KeyboardUsage::J), 'j', 'J', true},
    {U(KeyboardUsage::K), 'k', 'K', true},
    {U(KeyboardUsage::L), 'l', 'L', true},
    {U(KeyboardUsage::M), 'm', 'M', true},
    {U(KeyboardUsage::N), 'n', 'N', true},
    {U(KeyboardUsage::O), 'o', 'O', true},
    {U(KeyboardUsage::P), 'p', 'P', true},
    {U(KeyboardUsage::Q), 'q', 'Q', true},
    {U(KeyboardUsage::R), 'r', 'R', true},
    {U(KeyboardUsage::S), 's', 'S', true},
    {U(KeyboardUsage::T), 't', 'T', true},
    {U(KeyboardUsage::U), 'u', 'U', true},
    {U(KeyboardUsage::V), 'v', 'V', true},
    {U(KeyboardUsage::W), 'w', 'W', true},
    {U(KeyboardUsage::X), 'x', 'X', true},
    {U(KeyboardUsage::Y), 'y', 'Y', true},
    {U(KeyboardUsage::Z), 'z', 'Z', true},
    {U(KeyboardUsage::Digit1), '1', '!', false, '|'},
    {U(KeyboardUsage::Digit2), '2', '"', false, '@'},
    {U(KeyboardUsage::Digit3), '3', 0x00b7, false, '#'},
    {U(KeyboardUsage::Digit4), '4', '$', false, '~'},
    {U(KeyboardUsage::Digit5), '5', '%', false},
    {U(KeyboardUsage::Digit6), '6', '&', false, 0x00ac},
    {U(KeyboardUsage::Digit7), '7', '/', false},
    {U(KeyboardUsage::Digit8), '8', '(', false},
    {U(KeyboardUsage::Digit9), '9', ')', false},
    {U(KeyboardUsage::Digit0), '0', '=', false},
    {U(KeyboardUsage::Space), ' ', ' ', false},
    {U(KeyboardUsage::Minus), '\'', '?', false},
    {U(KeyboardUsage::Equal), 0x00a1, 0x00bf, false},
    {U(KeyboardUsage::LeftBracket), 0, 0, false, '['},
    {U(KeyboardUsage::RightBracket), '+', '*', false, ']'},
    {U(KeyboardUsage::NonUsHash), 0x00e7, 0x00c7, true, '}'},
    {U(KeyboardUsage::Semicolon), 0x00f1, 0x00d1, true},
    {U(KeyboardUsage::Quote), 0, 0, false, '{'},
    {U(KeyboardUsage::Grave), 0x00ba, 0x00aa, false, '\\'},
    {U(KeyboardUsage::Comma), ',', ';', false},
    {U(KeyboardUsage::Period), '.', ':', false},
    {U(KeyboardUsage::Slash), '-', '_', false},
    {U(KeyboardUsage::NonUsBackslash), '<', '>', false},
};

const KeyboardLayoutEntry kItItEntries[] = {
    {U(KeyboardUsage::A), 'a', 'A', true},
    {U(KeyboardUsage::B), 'b', 'B', true},
    {U(KeyboardUsage::C), 'c', 'C', true},
    {U(KeyboardUsage::D), 'd', 'D', true},
    {U(KeyboardUsage::E), 'e', 'E', true, 0x20ac},
    {U(KeyboardUsage::F), 'f', 'F', true},
    {U(KeyboardUsage::G), 'g', 'G', true},
    {U(KeyboardUsage::H), 'h', 'H', true},
    {U(KeyboardUsage::I), 'i', 'I', true},
    {U(KeyboardUsage::J), 'j', 'J', true},
    {U(KeyboardUsage::K), 'k', 'K', true},
    {U(KeyboardUsage::L), 'l', 'L', true},
    {U(KeyboardUsage::M), 'm', 'M', true},
    {U(KeyboardUsage::N), 'n', 'N', true},
    {U(KeyboardUsage::O), 'o', 'O', true},
    {U(KeyboardUsage::P), 'p', 'P', true},
    {U(KeyboardUsage::Q), 'q', 'Q', true},
    {U(KeyboardUsage::R), 'r', 'R', true},
    {U(KeyboardUsage::S), 's', 'S', true},
    {U(KeyboardUsage::T), 't', 'T', true},
    {U(KeyboardUsage::U), 'u', 'U', true},
    {U(KeyboardUsage::V), 'v', 'V', true},
    {U(KeyboardUsage::W), 'w', 'W', true},
    {U(KeyboardUsage::X), 'x', 'X', true},
    {U(KeyboardUsage::Y), 'y', 'Y', true},
    {U(KeyboardUsage::Z), 'z', 'Z', true},
    {U(KeyboardUsage::Digit1), '1', '!', false},
    {U(KeyboardUsage::Digit2), '2', '"', false},
    {U(KeyboardUsage::Digit3), '3', 0x00a3, false},
    {U(KeyboardUsage::Digit4), '4', '$', false},
    {U(KeyboardUsage::Digit5), '5', '%', false},
    {U(KeyboardUsage::Digit6), '6', '&', false},
    {U(KeyboardUsage::Digit7), '7', '/', false},
    {U(KeyboardUsage::Digit8), '8', '(', false},
    {U(KeyboardUsage::Digit9), '9', ')', false},
    {U(KeyboardUsage::Digit0), '0', '=', false},
    {U(KeyboardUsage::Space), ' ', ' ', false},
    {U(KeyboardUsage::Minus), '\'', '?', false},
    {U(KeyboardUsage::Equal), 0x00ec, '^', false},
    {U(KeyboardUsage::LeftBracket), 0x00e8, 0x00e9, false, '[', '{'},
    {U(KeyboardUsage::RightBracket), '+', '*', false, ']', '}'},
    {U(KeyboardUsage::NonUsHash), 0x00f9, 0x00a7, false},
    {U(KeyboardUsage::Semicolon), 0x00f2, 0x00e7, false, '@'},
    {U(KeyboardUsage::Quote), 0x00e0, 0x00b0, false, '#'},
    {U(KeyboardUsage::Grave), '\\', '|', false},
    {U(KeyboardUsage::Comma), ',', ';', false},
    {U(KeyboardUsage::Period), '.', ':', false},
    {U(KeyboardUsage::Slash), '-', '_', false},
    {U(KeyboardUsage::NonUsBackslash), '<', '>', false},
};

const KeyboardLayoutEntry kNlNlEntries[] = {
    {U(KeyboardUsage::A), 'a', 'A', true},
    {U(KeyboardUsage::B), 'b', 'B', true},
    {U(KeyboardUsage::C), 'c', 'C', true, 0x00a2},
    {U(KeyboardUsage::D), 'd', 'D', true},
    {U(KeyboardUsage::E), 'e', 'E', true, 0x20ac},
    {U(KeyboardUsage::F), 'f', 'F', true},
    {U(KeyboardUsage::G), 'g', 'G', true},
    {U(KeyboardUsage::H), 'h', 'H', true},
    {U(KeyboardUsage::I), 'i', 'I', true},
    {U(KeyboardUsage::J), 'j', 'J', true},
    {U(KeyboardUsage::K), 'k', 'K', true},
    {U(KeyboardUsage::L), 'l', 'L', true},
    {U(KeyboardUsage::M), 'm', 'M', true, 0x00b5},
    {U(KeyboardUsage::N), 'n', 'N', true},
    {U(KeyboardUsage::O), 'o', 'O', true},
    {U(KeyboardUsage::P), 'p', 'P', true},
    {U(KeyboardUsage::Q), 'q', 'Q', true},
    {U(KeyboardUsage::R), 'r', 'R', true, 0x00b6},
    {U(KeyboardUsage::S), 's', 'S', true, 0x00df},
    {U(KeyboardUsage::T), 't', 'T', true},
    {U(KeyboardUsage::U), 'u', 'U', true},
    {U(KeyboardUsage::V), 'v', 'V', true},
    {U(KeyboardUsage::W), 'w', 'W', true},
    {U(KeyboardUsage::X), 'x', 'X', true, 0x00bb},
    {U(KeyboardUsage::Y), 'y', 'Y', true},
    {U(KeyboardUsage::Z), 'z', 'Z', true, 0x00ab},
    {U(KeyboardUsage::Digit1), '1', '!', false, 0x00b9},
    {U(KeyboardUsage::Digit2), '2', '"', false, 0x00b2},
    {U(KeyboardUsage::Digit3), '3', '#', false, 0x00b3},
    {U(KeyboardUsage::Digit4), '4', '$', false, 0x00bc},
    {U(KeyboardUsage::Digit5), '5', '%', false, 0x00bd},
    {U(KeyboardUsage::Digit6), '6', '&', false, 0x00be},
    {U(KeyboardUsage::Digit7), '7', '_', false, 0x00a3},
    {U(KeyboardUsage::Digit8), '8', '(', false, '{'},
    {U(KeyboardUsage::Digit9), '9', ')', false, '}'},
    {U(KeyboardUsage::Digit0), '0', '\'', false},
    {U(KeyboardUsage::Space), ' ', ' ', false},
    {U(KeyboardUsage::Minus), '/', '?', false},
    {U(KeyboardUsage::Equal), 0x00b0, 0, false},
    {U(KeyboardUsage::RightBracket), '*', '|', false},
    {U(KeyboardUsage::NonUsHash), '<', '>', false},
    {U(KeyboardUsage::Semicolon), '+', 0x00b1, false},
    {U(KeyboardUsage::Grave), '@', 0x00a7, false},
    {U(KeyboardUsage::Comma), ',', ';', false},
    {U(KeyboardUsage::Period), '.', ':', false},
    {U(KeyboardUsage::Slash), '-', '=', false},
    {U(KeyboardUsage::NonUsBackslash), ']', '[', false},
};

const KeyboardLayoutEntry kDaDkEntries[] = {
    {U(KeyboardUsage::A), 'a', 'A', true},
    {U(KeyboardUsage::B), 'b', 'B', true},
    {U(KeyboardUsage::C), 'c', 'C', true},
    {U(KeyboardUsage::D), 'd', 'D', true},
    {U(KeyboardUsage::E), 'e', 'E', true, 0x20ac},
    {U(KeyboardUsage::F), 'f', 'F', true},
    {U(KeyboardUsage::G), 'g', 'G', true},
    {U(KeyboardUsage::H), 'h', 'H', true},
    {U(KeyboardUsage::I), 'i', 'I', true},
    {U(KeyboardUsage::J), 'j', 'J', true},
    {U(KeyboardUsage::K), 'k', 'K', true},
    {U(KeyboardUsage::L), 'l', 'L', true},
    {U(KeyboardUsage::M), 'm', 'M', true, 0x00b5},
    {U(KeyboardUsage::N), 'n', 'N', true},
    {U(KeyboardUsage::O), 'o', 'O', true},
    {U(KeyboardUsage::P), 'p', 'P', true},
    {U(KeyboardUsage::Q), 'q', 'Q', true},
    {U(KeyboardUsage::R), 'r', 'R', true},
    {U(KeyboardUsage::S), 's', 'S', true},
    {U(KeyboardUsage::T), 't', 'T', true},
    {U(KeyboardUsage::U), 'u', 'U', true},
    {U(KeyboardUsage::V), 'v', 'V', true},
    {U(KeyboardUsage::W), 'w', 'W', true},
    {U(KeyboardUsage::X), 'x', 'X', true},
    {U(KeyboardUsage::Y), 'y', 'Y', true},
    {U(KeyboardUsage::Z), 'z', 'Z', true},
    {U(KeyboardUsage::Digit1), '1', '!', false},
    {U(KeyboardUsage::Digit2), '2', '"', false, '@'},
    {U(KeyboardUsage::Digit3), '3', '#', false, 0x00a3},
    {U(KeyboardUsage::Digit4), '4', 0x00a4, false, '$'},
    {U(KeyboardUsage::Digit5), '5', '%', false, 0x20ac},
    {U(KeyboardUsage::Digit6), '6', '&', false},
    {U(KeyboardUsage::Digit7), '7', '/', false, '{'},
    {U(KeyboardUsage::Digit8), '8', '(', false, '['},
    {U(KeyboardUsage::Digit9), '9', ')', false, ']'},
    {U(KeyboardUsage::Digit0), '0', '=', false, '}'},
    {U(KeyboardUsage::Space), ' ', ' ', false},
    {U(KeyboardUsage::Minus), '+', '?', false},
    {U(KeyboardUsage::Equal), 0, 0, false, '|'},
    {U(KeyboardUsage::LeftBracket), 0x00e5, 0x00c5, true},
    {U(KeyboardUsage::NonUsHash), '\'', '*', false},
    {U(KeyboardUsage::Semicolon), 0x00e6, 0x00c6, true},
    {U(KeyboardUsage::Quote), 0x00f8, 0x00d8, true},
    {U(KeyboardUsage::Grave), 0x00bd, 0x00a7, false},
    {U(KeyboardUsage::Comma), ',', ';', false},
    {U(KeyboardUsage::Period), '.', ':', false},
    {U(KeyboardUsage::Slash), '-', '_', false},
    {U(KeyboardUsage::NonUsBackslash), '<', '>', false, '\\'},
};

const KeyboardLayoutEntry kNbNoEntries[] = {
    {U(KeyboardUsage::A), 'a', 'A', true},
    {U(KeyboardUsage::B), 'b', 'B', true},
    {U(KeyboardUsage::C), 'c', 'C', true},
    {U(KeyboardUsage::D), 'd', 'D', true},
    {U(KeyboardUsage::E), 'e', 'E', true, 0x20ac},
    {U(KeyboardUsage::F), 'f', 'F', true},
    {U(KeyboardUsage::G), 'g', 'G', true},
    {U(KeyboardUsage::H), 'h', 'H', true},
    {U(KeyboardUsage::I), 'i', 'I', true},
    {U(KeyboardUsage::J), 'j', 'J', true},
    {U(KeyboardUsage::K), 'k', 'K', true},
    {U(KeyboardUsage::L), 'l', 'L', true},
    {U(KeyboardUsage::M), 'm', 'M', true, 0x00b5},
    {U(KeyboardUsage::N), 'n', 'N', true},
    {U(KeyboardUsage::O), 'o', 'O', true},
    {U(KeyboardUsage::P), 'p', 'P', true},
    {U(KeyboardUsage::Q), 'q', 'Q', true},
    {U(KeyboardUsage::R), 'r', 'R', true},
    {U(KeyboardUsage::S), 's', 'S', true},
    {U(KeyboardUsage::T), 't', 'T', true},
    {U(KeyboardUsage::U), 'u', 'U', true},
    {U(KeyboardUsage::V), 'v', 'V', true},
    {U(KeyboardUsage::W), 'w', 'W', true},
    {U(KeyboardUsage::X), 'x', 'X', true},
    {U(KeyboardUsage::Y), 'y', 'Y', true},
    {U(KeyboardUsage::Z), 'z', 'Z', true},
    {U(KeyboardUsage::Digit1), '1', '!', false},
    {U(KeyboardUsage::Digit2), '2', '"', false, '@'},
    {U(KeyboardUsage::Digit3), '3', '#', false, 0x00a3},
    {U(KeyboardUsage::Digit4), '4', 0x00a4, false, '$'},
    {U(KeyboardUsage::Digit5), '5', '%', false, 0x20ac},
    {U(KeyboardUsage::Digit6), '6', '&', false},
    {U(KeyboardUsage::Digit7), '7', '/', false, '{'},
    {U(KeyboardUsage::Digit8), '8', '(', false, '['},
    {U(KeyboardUsage::Digit9), '9', ')', false, ']'},
    {U(KeyboardUsage::Digit0), '0', '=', false, '}'},
    {U(KeyboardUsage::Space), ' ', ' ', false},
    {U(KeyboardUsage::Minus), '+', '?', false},
    {U(KeyboardUsage::LeftBracket), 0x00e5, 0x00c5, true},
    {U(KeyboardUsage::NonUsHash), '\'', '*', false},
    {U(KeyboardUsage::Semicolon), 0x00f8, 0x00d8, true},
    {U(KeyboardUsage::Quote), 0x00e6, 0x00c6, true},
    {U(KeyboardUsage::Grave), '|', 0x00a7, false},
    {U(KeyboardUsage::Comma), ',', ';', false},
    {U(KeyboardUsage::Period), '.', ':', false},
    {U(KeyboardUsage::Slash), '-', '_', false},
    {U(KeyboardUsage::NonUsBackslash), '<', '>', false, '\\'},
};

const KeyboardLayoutEntry kSvSeEntries[] = {
    {U(KeyboardUsage::A), 'a', 'A', true},
    {U(KeyboardUsage::B), 'b', 'B', true},
    {U(KeyboardUsage::C), 'c', 'C', true},
    {U(KeyboardUsage::D), 'd', 'D', true},
    {U(KeyboardUsage::E), 'e', 'E', true, 0x00ac},
    {U(KeyboardUsage::F), 'f', 'F', true},
    {U(KeyboardUsage::G), 'g', 'G', true},
    {U(KeyboardUsage::H), 'h', 'H', true},
    {U(KeyboardUsage::I), 'i', 'I', true},
    {U(KeyboardUsage::J), 'j', 'J', true},
    {U(KeyboardUsage::K), 'k', 'K', true},
    {U(KeyboardUsage::L), 'l', 'L', true},
    {U(KeyboardUsage::M), 'm', 'M', true, 0x00b5},
    {U(KeyboardUsage::N), 'n', 'N', true},
    {U(KeyboardUsage::O), 'o', 'O', true},
    {U(KeyboardUsage::P), 'p', 'P', true},
    {U(KeyboardUsage::Q), 'q', 'Q', true},
    {U(KeyboardUsage::R), 'r', 'R', true},
    {U(KeyboardUsage::S), 's', 'S', true},
    {U(KeyboardUsage::T), 't', 'T', true},
    {U(KeyboardUsage::U), 'u', 'U', true},
    {U(KeyboardUsage::V), 'v', 'V', true},
    {U(KeyboardUsage::W), 'w', 'W', true},
    {U(KeyboardUsage::X), 'x', 'X', true},
    {U(KeyboardUsage::Y), 'y', 'Y', true},
    {U(KeyboardUsage::Z), 'z', 'Z', true},
    {U(KeyboardUsage::Digit1), '1', '!', false},
    {U(KeyboardUsage::Digit2), '2', '"', false, '@'},
    {U(KeyboardUsage::Digit3), '3', '#', false, 0x00a3},
    {U(KeyboardUsage::Digit4), '4', 0x00a4, false, '$'},
    {U(KeyboardUsage::Digit5), '5', '%', false, 0x00ac},
    {U(KeyboardUsage::Digit6), '6', '&', false},
    {U(KeyboardUsage::Digit7), '7', '/', false, '{'},
    {U(KeyboardUsage::Digit8), '8', '(', false, '['},
    {U(KeyboardUsage::Digit9), '9', ')', false, ']'},
    {U(KeyboardUsage::Digit0), '0', '=', false, '}'},
    {U(KeyboardUsage::Space), ' ', ' ', false},
    {U(KeyboardUsage::Minus), '+', '?', false, '\\'},
    {U(KeyboardUsage::LeftBracket), 0x00e5, 0x00c5, true},
    {U(KeyboardUsage::RightBracket), 0, 0, false, '~'},
    {U(KeyboardUsage::NonUsHash), '\'', '*', false},
    {U(KeyboardUsage::Semicolon), 0x00f6, 0x00d6, true},
    {U(KeyboardUsage::Quote), 0x00e4, 0x00c4, true},
    {U(KeyboardUsage::Grave), 0x00a7, 0x00bd, false},
    {U(KeyboardUsage::Comma), ',', ';', false},
    {U(KeyboardUsage::Period), '.', ':', false},
    {U(KeyboardUsage::Slash), '-', '_', false},
    {U(KeyboardUsage::NonUsBackslash), '<', '>', false, '|'},
};

const KeyboardLayoutEntry kFiFiEntries[] = {
    {U(KeyboardUsage::A), 'a', 'A', true},
    {U(KeyboardUsage::B), 'b', 'B', true},
    {U(KeyboardUsage::C), 'c', 'C', true},
    {U(KeyboardUsage::D), 'd', 'D', true},
    {U(KeyboardUsage::E), 'e', 'E', true, 0x20ac},
    {U(KeyboardUsage::F), 'f', 'F', true},
    {U(KeyboardUsage::G), 'g', 'G', true},
    {U(KeyboardUsage::H), 'h', 'H', true},
    {U(KeyboardUsage::I), 'i', 'I', true},
    {U(KeyboardUsage::J), 'j', 'J', true},
    {U(KeyboardUsage::K), 'k', 'K', true},
    {U(KeyboardUsage::L), 'l', 'L', true},
    {U(KeyboardUsage::M), 'm', 'M', true, 0x00b5},
    {U(KeyboardUsage::N), 'n', 'N', true},
    {U(KeyboardUsage::O), 'o', 'O', true},
    {U(KeyboardUsage::P), 'p', 'P', true},
    {U(KeyboardUsage::Q), 'q', 'Q', true},
    {U(KeyboardUsage::R), 'r', 'R', true},
    {U(KeyboardUsage::S), 's', 'S', true},
    {U(KeyboardUsage::T), 't', 'T', true},
    {U(KeyboardUsage::U), 'u', 'U', true},
    {U(KeyboardUsage::V), 'v', 'V', true},
    {U(KeyboardUsage::W), 'w', 'W', true},
    {U(KeyboardUsage::X), 'x', 'X', true},
    {U(KeyboardUsage::Y), 'y', 'Y', true},
    {U(KeyboardUsage::Z), 'z', 'Z', true},
    {U(KeyboardUsage::Digit1), '1', '!', false},
    {U(KeyboardUsage::Digit2), '2', '"', false, '@'},
    {U(KeyboardUsage::Digit3), '3', '#', false, 0x00a3},
    {U(KeyboardUsage::Digit4), '4', 0x00a4, false, '$'},
    {U(KeyboardUsage::Digit5), '5', '%', false, 0x20ac},
    {U(KeyboardUsage::Digit6), '6', '&', false},
    {U(KeyboardUsage::Digit7), '7', '/', false, '{'},
    {U(KeyboardUsage::Digit8), '8', '(', false, '['},
    {U(KeyboardUsage::Digit9), '9', ')', false, ']'},
    {U(KeyboardUsage::Digit0), '0', '=', false, '}'},
    {U(KeyboardUsage::Space), ' ', ' ', false},
    {U(KeyboardUsage::Minus), '+', '?', false, '\\'},
    {U(KeyboardUsage::LeftBracket), 0x00e5, 0x00c5, true},
    {U(KeyboardUsage::NonUsHash), '\'', '*', false},
    {U(KeyboardUsage::Semicolon), 0x00f6, 0x00d6, true},
    {U(KeyboardUsage::Quote), 0x00e4, 0x00c4, true},
    {U(KeyboardUsage::Grave), 0x00a7, 0x00bd, false},
    {U(KeyboardUsage::Comma), ',', ';', false},
    {U(KeyboardUsage::Period), '.', ':', false},
    {U(KeyboardUsage::Slash), '-', '_', false},
    {U(KeyboardUsage::NonUsBackslash), '<', '>', false, '|'},
};

const KeyboardLayoutEntry kEnGbEntries[] = {
    {U(KeyboardUsage::A), 'a', 'A', true},
    {U(KeyboardUsage::B), 'b', 'B', true},
    {U(KeyboardUsage::C), 'c', 'C', true},
    {U(KeyboardUsage::D), 'd', 'D', true},
    {U(KeyboardUsage::E), 'e', 'E', true},
    {U(KeyboardUsage::F), 'f', 'F', true},
    {U(KeyboardUsage::G), 'g', 'G', true},
    {U(KeyboardUsage::H), 'h', 'H', true},
    {U(KeyboardUsage::I), 'i', 'I', true},
    {U(KeyboardUsage::J), 'j', 'J', true},
    {U(KeyboardUsage::K), 'k', 'K', true},
    {U(KeyboardUsage::L), 'l', 'L', true},
    {U(KeyboardUsage::M), 'm', 'M', true},
    {U(KeyboardUsage::N), 'n', 'N', true},
    {U(KeyboardUsage::O), 'o', 'O', true},
    {U(KeyboardUsage::P), 'p', 'P', true},
    {U(KeyboardUsage::Q), 'q', 'Q', true},
    {U(KeyboardUsage::R), 'r', 'R', true},
    {U(KeyboardUsage::S), 's', 'S', true},
    {U(KeyboardUsage::T), 't', 'T', true},
    {U(KeyboardUsage::U), 'u', 'U', true},
    {U(KeyboardUsage::V), 'v', 'V', true},
    {U(KeyboardUsage::W), 'w', 'W', true},
    {U(KeyboardUsage::X), 'x', 'X', true},
    {U(KeyboardUsage::Y), 'y', 'Y', true},
    {U(KeyboardUsage::Z), 'z', 'Z', true},
    {U(KeyboardUsage::Digit1), '1', '!', false},
    {U(KeyboardUsage::Digit2), '2', '"', false},
    {U(KeyboardUsage::Digit3), '3', 0x00a3, false},
    {U(KeyboardUsage::Digit4), '4', '$', false, 0x20ac},
    {U(KeyboardUsage::Digit5), '5', '%', false},
    {U(KeyboardUsage::Digit6), '6', '^', false},
    {U(KeyboardUsage::Digit7), '7', '&', false},
    {U(KeyboardUsage::Digit8), '8', '*', false},
    {U(KeyboardUsage::Digit9), '9', '(', false},
    {U(KeyboardUsage::Digit0), '0', ')', false},
    {U(KeyboardUsage::Space), ' ', ' ', false},
    {U(KeyboardUsage::Minus), '-', '_', false},
    {U(KeyboardUsage::Equal), '=', '+', false},
    {U(KeyboardUsage::LeftBracket), '[', '{', false},
    {U(KeyboardUsage::RightBracket), ']', '}', false},
    {U(KeyboardUsage::NonUsHash), '#', '~', false},
    {U(KeyboardUsage::Semicolon), ';', ':', false},
    {U(KeyboardUsage::Quote), '\'', '@', false},
    {U(KeyboardUsage::Grave), '`', 0x00ac, false, 0x00a6},
    {U(KeyboardUsage::Comma), ',', '<', false},
    {U(KeyboardUsage::Period), '.', '>', false},
    {U(KeyboardUsage::Slash), '/', '?', false},
    {U(KeyboardUsage::NonUsBackslash), '\\', '|', false},
};

const KeyboardLayoutEntry kPtPtEntries[] = {
    {U(KeyboardUsage::A), 'a', 'A', true},
    {U(KeyboardUsage::B), 'b', 'B', true},
    {U(KeyboardUsage::C), 'c', 'C', true},
    {U(KeyboardUsage::D), 'd', 'D', true},
    {U(KeyboardUsage::E), 'e', 'E', true, 0x20ac},
    {U(KeyboardUsage::F), 'f', 'F', true},
    {U(KeyboardUsage::G), 'g', 'G', true},
    {U(KeyboardUsage::H), 'h', 'H', true},
    {U(KeyboardUsage::I), 'i', 'I', true},
    {U(KeyboardUsage::J), 'j', 'J', true},
    {U(KeyboardUsage::K), 'k', 'K', true},
    {U(KeyboardUsage::L), 'l', 'L', true},
    {U(KeyboardUsage::M), 'm', 'M', true},
    {U(KeyboardUsage::N), 'n', 'N', true},
    {U(KeyboardUsage::O), 'o', 'O', true},
    {U(KeyboardUsage::P), 'p', 'P', true},
    {U(KeyboardUsage::Q), 'q', 'Q', true},
    {U(KeyboardUsage::R), 'r', 'R', true},
    {U(KeyboardUsage::S), 's', 'S', true},
    {U(KeyboardUsage::T), 't', 'T', true},
    {U(KeyboardUsage::U), 'u', 'U', true},
    {U(KeyboardUsage::V), 'v', 'V', true},
    {U(KeyboardUsage::W), 'w', 'W', true},
    {U(KeyboardUsage::X), 'x', 'X', true},
    {U(KeyboardUsage::Y), 'y', 'Y', true},
    {U(KeyboardUsage::Z), 'z', 'Z', true},
    {U(KeyboardUsage::Digit1), '1', '!', false},
    {U(KeyboardUsage::Digit2), '2', '"', false, '@'},
    {U(KeyboardUsage::Digit3), '3', '#', false, 0x00a3},
    {U(KeyboardUsage::Digit4), '4', '$', false, 0x00a7},
    {U(KeyboardUsage::Digit5), '5', '%', false},
    {U(KeyboardUsage::Digit6), '6', '&', false},
    {U(KeyboardUsage::Digit7), '7', '/', false, '{'},
    {U(KeyboardUsage::Digit8), '8', '(', false, '['},
    {U(KeyboardUsage::Digit9), '9', ')', false, ']'},
    {U(KeyboardUsage::Digit0), '0', '=', false, '}'},
    {U(KeyboardUsage::Space), ' ', ' ', false},
    {U(KeyboardUsage::Minus), '\'', '?', false},
    {U(KeyboardUsage::Equal), 0x00ab, 0x00bb, false},
    {U(KeyboardUsage::LeftBracket), '+', '*', false},
    {U(KeyboardUsage::Semicolon), 0x00e7, 0x00c7, true},
    {U(KeyboardUsage::Quote), 0x00ba, 0x00aa, false},
    {U(KeyboardUsage::Grave), '\\', '|', false},
    {U(KeyboardUsage::Comma), ',', ';', false},
    {U(KeyboardUsage::Period), '.', ':', false},
    {U(KeyboardUsage::Slash), '-', '_', false},
    {U(KeyboardUsage::NonUsBackslash), '<', '>', false},
};

const KeyboardLayoutEntry kPtBrEntries[] = {
    {U(KeyboardUsage::A), 'a', 'A', true},
    {U(KeyboardUsage::B), 'b', 'B', true},
    {U(KeyboardUsage::C), 'c', 'C', true, 0x20a2},
    {U(KeyboardUsage::D), 'd', 'D', true},
    {U(KeyboardUsage::E), 'e', 'E', true, 0x00b0},
    {U(KeyboardUsage::F), 'f', 'F', true},
    {U(KeyboardUsage::G), 'g', 'G', true},
    {U(KeyboardUsage::H), 'h', 'H', true},
    {U(KeyboardUsage::I), 'i', 'I', true},
    {U(KeyboardUsage::J), 'j', 'J', true},
    {U(KeyboardUsage::K), 'k', 'K', true},
    {U(KeyboardUsage::L), 'l', 'L', true},
    {U(KeyboardUsage::M), 'm', 'M', true},
    {U(KeyboardUsage::N), 'n', 'N', true},
    {U(KeyboardUsage::O), 'o', 'O', true},
    {U(KeyboardUsage::P), 'p', 'P', true},
    {U(KeyboardUsage::Q), 'q', 'Q', true, '/'},
    {U(KeyboardUsage::R), 'r', 'R', true},
    {U(KeyboardUsage::S), 's', 'S', true},
    {U(KeyboardUsage::T), 't', 'T', true},
    {U(KeyboardUsage::U), 'u', 'U', true},
    {U(KeyboardUsage::V), 'v', 'V', true},
    {U(KeyboardUsage::W), 'w', 'W', true, '?'},
    {U(KeyboardUsage::X), 'x', 'X', true},
    {U(KeyboardUsage::Y), 'y', 'Y', true},
    {U(KeyboardUsage::Z), 'z', 'Z', true},
    {U(KeyboardUsage::Digit1), '1', '!', false, 0x00b9},
    {U(KeyboardUsage::Digit2), '2', '@', false, 0x00b2},
    {U(KeyboardUsage::Digit3), '3', '#', false, 0x00b3},
    {U(KeyboardUsage::Digit4), '4', '$', false, 0x00a3},
    {U(KeyboardUsage::Digit5), '5', '%', false, 0x00a2},
    {U(KeyboardUsage::Digit6), '6', 0, false, 0x00ac},
    {U(KeyboardUsage::Digit7), '7', '&', false},
    {U(KeyboardUsage::Digit8), '8', '*', false},
    {U(KeyboardUsage::Digit9), '9', '(', false},
    {U(KeyboardUsage::Digit0), '0', ')', false},
    {U(KeyboardUsage::Space), ' ', ' ', false},
    {U(KeyboardUsage::Minus), '-', '_', false},
    {U(KeyboardUsage::Equal), '=', '+', false, 0x00a7},
    {U(KeyboardUsage::RightBracket), '[', '{', false, 0x00aa},
    {U(KeyboardUsage::Backslash), ']', '}', false, 0x00ba},
    {U(KeyboardUsage::Semicolon), 0x00e7, 0x00c7, true},
    {U(KeyboardUsage::Grave), '\'', '"', false},
    {U(KeyboardUsage::Comma), ',', '<', false},
    {U(KeyboardUsage::Period), '.', '>', false},
    {U(KeyboardUsage::Slash), ';', ':', false},
    {U(KeyboardUsage::NonUsBackslash), '\\', '|', false},
    {U(KeyboardUsage::International1), '/', '?', false},
};

const KeyboardLayoutEntry kFrChEntries[] = {
    {U(KeyboardUsage::A), 'a', 'A', true},
    {U(KeyboardUsage::B), 'b', 'B', true},
    {U(KeyboardUsage::C), 'c', 'C', true},
    {U(KeyboardUsage::D), 'd', 'D', true},
    {U(KeyboardUsage::E), 'e', 'E', true, 0x20ac},
    {U(KeyboardUsage::F), 'f', 'F', true},
    {U(KeyboardUsage::G), 'g', 'G', true},
    {U(KeyboardUsage::H), 'h', 'H', true},
    {U(KeyboardUsage::I), 'i', 'I', true},
    {U(KeyboardUsage::J), 'j', 'J', true},
    {U(KeyboardUsage::K), 'k', 'K', true},
    {U(KeyboardUsage::L), 'l', 'L', true},
    {U(KeyboardUsage::M), 'm', 'M', true},
    {U(KeyboardUsage::N), 'n', 'N', true},
    {U(KeyboardUsage::O), 'o', 'O', true},
    {U(KeyboardUsage::P), 'p', 'P', true},
    {U(KeyboardUsage::Q), 'q', 'Q', true},
    {U(KeyboardUsage::R), 'r', 'R', true},
    {U(KeyboardUsage::S), 's', 'S', true},
    {U(KeyboardUsage::T), 't', 'T', true},
    {U(KeyboardUsage::U), 'u', 'U', true},
    {U(KeyboardUsage::V), 'v', 'V', true},
    {U(KeyboardUsage::W), 'w', 'W', true},
    {U(KeyboardUsage::X), 'x', 'X', true},
    {U(KeyboardUsage::Y), 'z', 'Z', true},
    {U(KeyboardUsage::Z), 'y', 'Y', true},
    {U(KeyboardUsage::Digit1), '1', '+', false, '|'},
    {U(KeyboardUsage::Digit2), '2', '"', false, '@'},
    {U(KeyboardUsage::Digit3), '3', '*', false, '#'},
    {U(KeyboardUsage::Digit4), '4', 0x00e7, false, 0x00b0},
    {U(KeyboardUsage::Digit5), '5', '%', false, 0x00a7},
    {U(KeyboardUsage::Digit6), '6', '&', false, 0x00ac},
    {U(KeyboardUsage::Digit7), '7', '/', false, 0x00a6},
    {U(KeyboardUsage::Digit8), '8', '(', false, 0x00a2},
    {U(KeyboardUsage::Digit9), '9', ')', false},
    {U(KeyboardUsage::Digit0), '0', '=', false},
    {U(KeyboardUsage::Space), ' ', ' ', false},
    {U(KeyboardUsage::Minus), '\'', '?', false},
    {U(KeyboardUsage::LeftBracket), 0x00e8, 0x00fc, false, '['},
    {U(KeyboardUsage::RightBracket), 0, '!', false, ']'},
    {U(KeyboardUsage::NonUsHash), '$', 0x00a3, false, '}'},
    {U(KeyboardUsage::Semicolon), 0x00e9, 0x00f6, false},
    {U(KeyboardUsage::Quote), 0x00e0, 0x00e4, false, '{'},
    {U(KeyboardUsage::Grave), 0x00a7, 0x00b0, false},
    {U(KeyboardUsage::Comma), ',', ';', false},
    {U(KeyboardUsage::Period), '.', ':', false},
    {U(KeyboardUsage::Slash), '-', '_', false},
    {U(KeyboardUsage::NonUsBackslash), '<', '>', false},
};

const KeyboardLayoutEntry kHuHuEntries[] = {
    {U(KeyboardUsage::A), 'a', 'A', true, 0x00e4},
    {U(KeyboardUsage::B), 'b', 'B', true, '{'},
    {U(KeyboardUsage::C), 'c', 'C', true, '&'},
    {U(KeyboardUsage::D), 'd', 'D', true, 0x0110},
    {U(KeyboardUsage::E), 'e', 'E', true, 0x00c4},
    {U(KeyboardUsage::F), 'f', 'F', true, '['},
    {U(KeyboardUsage::G), 'g', 'G', true, ']'},
    {U(KeyboardUsage::H), 'h', 'H', true},
    {U(KeyboardUsage::I), 'i', 'I', true, 0x00cd},
    {U(KeyboardUsage::J), 'j', 'J', true, 0x00ed},
    {U(KeyboardUsage::K), 'k', 'K', true, 0x0142},
    {U(KeyboardUsage::L), 'l', 'L', true, 0x0141},
    {U(KeyboardUsage::M), 'm', 'M', true, '<'},
    {U(KeyboardUsage::N), 'n', 'N', true, '}'},
    {U(KeyboardUsage::O), 'o', 'O', true},
    {U(KeyboardUsage::P), 'p', 'P', true},
    {U(KeyboardUsage::Q), 'q', 'Q', true, '\\'},
    {U(KeyboardUsage::R), 'r', 'R', true},
    {U(KeyboardUsage::S), 's', 'S', true, 0x0111},
    {U(KeyboardUsage::T), 't', 'T', true},
    {U(KeyboardUsage::U), 'u', 'U', true, 0x20ac},
    {U(KeyboardUsage::V), 'v', 'V', true, '@'},
    {U(KeyboardUsage::W), 'w', 'W', true, '|'},
    {U(KeyboardUsage::X), 'x', 'X', true, '#'},
    {U(KeyboardUsage::Y), 'z', 'Z', true, '>'},
    {U(KeyboardUsage::Z), 'y', 'Y', true},
    {U(KeyboardUsage::Digit1), '1', '\'', false, '~'},
    {U(KeyboardUsage::Digit2), '2', '"', false, 0x02c7},
    {U(KeyboardUsage::Digit3), '3', '+', false, '^'},
    {U(KeyboardUsage::Digit4), '4', '!', false, 0x02d8},
    {U(KeyboardUsage::Digit5), '5', '%', false, 0x00b0},
    {U(KeyboardUsage::Digit6), '6', '/', false, 0x02db},
    {U(KeyboardUsage::Digit7), '7', '=', false, '`'},
    {U(KeyboardUsage::Digit8), '8', '(', false, 0x02d9},
    {U(KeyboardUsage::Digit9), '9', ')', false, 0x00b4},
    {U(KeyboardUsage::Digit0), 0x00f6, 0x00d6, true, 0x02dd},
    {U(KeyboardUsage::Space), ' ', ' ', false},
    {U(KeyboardUsage::Minus), 0x00fc, 0x00dc, true, 0x00a8},
    {U(KeyboardUsage::Equal), 0x00f3, 0x00d3, true, 0x00b8},
    {U(KeyboardUsage::LeftBracket), 0x0151, 0x0150, true, 0x00f7},
    {U(KeyboardUsage::RightBracket), 0x00fa, 0x00da, true, 0x00d7},
    {U(KeyboardUsage::Backslash), 0x0171, 0x0170, true, 0x00a4},
    {U(KeyboardUsage::Semicolon), 0x00e9, 0x00c9, true, '$'},
    {U(KeyboardUsage::Quote), 0x00e1, 0x00c1, true, 0x00df},
    {U(KeyboardUsage::Grave), '0', 0x00a7, false},
    {U(KeyboardUsage::Comma), ',', '?', false, ';'},
    {U(KeyboardUsage::Period), '.', ':', false, '>'},
    {U(KeyboardUsage::Slash), '-', '_', false, '*'},
    {U(KeyboardUsage::NonUsBackslash), 0x00ed, 0x00cd, true, '<'},
};

struct GeneratedLayout
{
  const char *name;
  const KeyboardLayoutEntry *entries;
  size_t count;
};

const GeneratedLayout kGeneratedLayouts[] = {
    {"de_de", kDeDeEntries, sizeof(kDeDeEntries) / sizeof(kDeDeEntries[0])},
    {"fr_fr", kFrFrEntries, sizeof(kFrFrEntries) / sizeof(kFrFrEntries[0])},
    {"es_es", kEsEsEntries, sizeof(kEsEsEntries) / sizeof(kEsEsEntries[0])},
    {"it_it", kItItEntries, sizeof(kItItEntries) / sizeof(kItItEntries[0])},
    {"nl_nl", kNlNlEntries, sizeof(kNlNlEntries) / sizeof(kNlNlEntries[0])},
    {"da_dk", kDaDkEntries, sizeof(kDaDkEntries) / sizeof(kDaDkEntries[0])},
    {"nb_no", kNbNoEntries, sizeof(kNbNoEntries) / sizeof(kNbNoEntries[0])},
    {"sv_se", kSvSeEntries, sizeof(kSvSeEntries) / sizeof(kSvSeEntries[0])},
    {"fi_fi", kFiFiEntries, sizeof(kFiFiEntries) / sizeof(kFiFiEntries[0])},
    {"en_gb", kEnGbEntries, sizeof(kEnGbEntries) / sizeof(kEnGbEntries[0])},
    {"pt_pt", kPtPtEntries, sizeof(kPtPtEntries) / sizeof(kPtPtEntries[0])},
    {"pt_br", kPtBrEntries, sizeof(kPtBrEntries) / sizeof(kPtBrEntries[0])},
    {"fr_ch", kFrChEntries, sizeof(kFrChEntries) / sizeof(kFrChEntries[0])},
    {"hu_hu", kHuHuEntries, sizeof(kHuHuEntries) / sizeof(kHuHuEntries[0])},
};
// clang-format on

